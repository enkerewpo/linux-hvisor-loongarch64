# 0 "loongson3_ls7a.dts"
# 0 "<built-in>"
# 0 "<command-line>"
# 1 "loongson3_ls7a.dts"
/dts-v1/;




# 1 "loongson3.dtsi" 1

/ {




 cpus {
  #address-cells = <1>;
  #size-cells = <0>;

  cpu@0 {
   compatible = "loongson,loongson3";
   device_type = "cpu";
   reg = <0x0>;
   l2-cache = <&vcache0>;
   next-level-cache = <&scache0>;
   numa-node-id = <0>;
  };
# 140 "loongson3.dtsi"
  vcache0: l2-cache0 {
   compatible = "cache";
   next-level-cache = <&scache0>;
  };

  vcache1: l2-cache1 {
   compatible = "cache";
   next-level-cache = <&scache0>;
  };

  vcache2: l2-cache2 {
   compatible = "cache";
   next-level-cache = <&scache0>;
  };

  vcache3: l2-cache3 {
   compatible = "cache";
   next-level-cache = <&scache0>;
  };

  vcache4: l2-cache4 {
   compatible = "cache";
   next-level-cache = <&scache1>;
  };

  vcache5: l2-cache5 {
   compatible = "cache";
   next-level-cache = <&scache1>;
  };

  vcache6: l2-cache6 {
   compatible = "cahce";
   next-level-cache = <&scache1>;
  };

  vcache7: l2-cache7 {
   compatible = "cache";
   next-level-cache = <&scache1>;
  };

  vcache8: l2-cache8 {
   compatible = "cache";
   next-level-cache = <&scache2>;
  };

  vcache9: l2-cache9 {
   compatible = "cache";
   next-level-cache = <&scache2>;
  };

  vcachea: l2-cachea {
   compatible = "cache";
   next-level-cache = <&scache2>;
  };

  vcacheb: l2-cacheb {
   compatible = "cache";
   next-level-cache = <&scache2>;
  };

  vcachec: l2-cachec {
   compatible = "cache";
   next-level-cache = <&scache3>;
  };

  vcached: l2-cached {
   compatible = "cache";
   next-level-cache = <&scache3>;
  };

  vcachee: l2-cachee {
   compatible = "cache";
   next-level-cache = <&scache3>;
  };

  vcachef: l2-cachef {
   compatible = "cache";
   next-level-cache = <&scache3>;
  };

  scache0: l3-cache0 {
   compatible = "cache";
  };

  scache1: l3-cache1 {
   compatible = "cache";
  };

  scache2: l3-cache2 {
   compatible = "cache";
  };

  scache3: l3-cache3 {
   compatible = "cache";
  };
 };
};
# 7 "loongson3_ls7a.dts" 2
/ {
 model = "loongson,generic";
 compatible = "loongson,loongson3";
 #address-cells = <2>;
 #size-cells = <2>;

 aliases {
  serial0 = &uart0;

 };

 chosen {
  stdout-path = "serial0:115200n8";
  bootargs = "earlycon console=ttyS0,115200n8 initramfs_async=false rootwait debug";
//   bootargs = "earlycon console=ttyS0,115200n8 initramfs_async=false rootwait nohlt";

 };

 hvisor_device {
  compatible = "hvisor";
  interrupt-parent = <0x01>;
  interrupts = <0x00 0x20 0x01>;
  };

 mem: memory {
  name = "memory";
  device_type = "memory";


  reg = <0 0x00200000 0 0x0ee00000
  0 0x90000000 0 0x10000000
  0 0xf0000000 0 0x10000000
  0 0xc0000000 0 0x30000000
  >;
 };

 reserved-memory {
	#address-cells = <0x02>;
	#size-cells = <0x02>;
	ranges;

	nonroot0xc0000000 {
		no-map;
		reg = <0x00 0xc0000000 0x00 0x30000000>;
	};
 };

 cpuic: interrupt-controller {
  compatible = "loongson,cpu-interrupt-controller";
  interrupt-controller;
  #interrupt-cells = <1>;
 };

 icu: interrupt-controller@1fe01400 {
  compatible = "loongson";
  interrupt-controller;
  #interrupt-cells = <1>;
  reg = <0 0x1fe01400 0 0x40
  0 0x1fe01040 0 16>;
  interrupt-parent = <&cpuic>;
  interrupt-names = "cascade";
  interrupts = <3>;
 };

 board: platform {
  compatible = "loongson,nbus", "simple-bus";
  #address-cells = <2>;
  #size-cells = <2>;

  ranges = <0 0x10000000 0 0x10000000 0 0x10000000
  0 0x2000000 0 0x2000000 0 0x2000000
  0 0x20000000 0 0x20000000 0 0x10000000
  0 0x40000000 0 0x40000000 0 0x40000000
  0xfe 0x00000000 0xfe 0x00000000 0 0x40000000>;

  osc_clk: osc-clock@0 {
   #clock-cells = <0>;
   compatible = "fixed-clock";
   clock-frequency = <100000000>;
   clock-output-names = "ref_clk";
   reg = <0 0 0 0>;
  };

  clks: clock-controller@1fe00480 {
   compatible = "loongson,ls2x-clk";
   reg = <0 0x1fe00480 0 1>;
   clocks = <&osc_clk>;
   clock-names = "ref_clk";
   #clock-cells = <1>;
  };

  uart0: serial@1fe001e0 {
   device_type = "serial";
   compatible = "ns16550a";
   reg = <0 0x1fe001e0 0 0x10>;
   clocks = <&clks 12>;
   clock-frequency = <100000000>;

   interrupt-parent = <&icu>;
   no-loopback-test;
   status = "okay";
  };
# 104 "loongson3_ls7a.dts"
 };
};
